## ethan_adafruit_kb2040/Kconfig.board
```kconfig
# Copyright (c) 2022 Pete Johanson
# SPDX-License-Identifier: Apache-2.0

config BOARD_ETHAN_ADAFRUIT_KB2040
	bool "Ethan Adafruit KB2040 Board"
	depends on SOC_RP2040
```

## ethan_adafruit_kb2040/Kconfig.defconfig
```kconfig
# Copyright (c) 2022 Peter Johanson
# SPDX-License-Identifier: Apache-2.0

if BOARD_ETHAN_ADAFRUIT_KB2040

config BOARD
	default "ethan_adafruit_kb2040"

config RP2_FLASH_W25Q080
	default y

#
#config LV_Z_VDB_SIZE
#	default 64
#
#config LV_Z_DPI
#	default 148
#
#config LV_Z_BITS_PER_PIXEL
#	default 1
#
#choice LV_COLOR_DEPTH
#	default LV_COLOR_DEPTH_1
#endchoice

endif # BOARD_ADAFRUIT_KB2040
```

## ethan_adafruit_kb2040/ethan_adafruit_kb2040_defconfig
```kconfig
# SPDX-License-Identifier: Apache-2.0

CONFIG_SOC_SERIES_RP2XXX=y
CONFIG_SOC_RP2040=y
CONFIG_BOARD_ETHAN_ADAFRUIT_KB2040=y

CONFIG_SYS_CLOCK_HW_CYCLES_PER_SEC=125000000

# enable uart driver
CONFIG_SERIAL=y
CONFIG_UART_INTERRUPT_DRIVEN=y

# enable console
CONFIG_CONSOLE=y
CONFIG_UART_CONSOLE=y

# Enable reset by default
CONFIG_RESET=y

# Code partition needed to target the correct flash range
CONFIG_USE_DT_CODE_PARTITION=y

# Output UF2 by default, native bootloader supports it.
CONFIG_BUILD_OUTPUT_UF2=y

CONFIG_SPI=y
CONFIG_GPIO=y
CONFIG_CAN=y


#CONFIG_USB_DEVICE_STACK=y
#CONFIG_USB_DEVICE_PRODUCT="ethan Zephyr USB shell sample"
#CONFIG_SHELL_BACKEND_SERIAL_CHECK_DTR=y
#CONFIG_UART_LINE_CTRL=y
#CONFIG_SHELL_BACKEND_SERIAL_INIT_PRIORITY=51
#CONFIG_USB_DEVICE_INITIALIZE_AT_BOOT=n
```
