## CMakeLists.txt
```
# SPDX-License-Identifier: Apache-2.0

cmake_minimum_required(VERSION 3.20.0)


find_package(Zephyr REQUIRED HINTS $ENV{ZEPHYR_BASE})
project(CAN)

#target_sources(app PRIVATE src/main.c)

FILE(GLOB u8g2csrc u8g2/csrc/*.c)
target_sources(app PRIVATE src/main.c src/u8g2port.c ${u8g2csrc})
```

## prj.conf
```kconfig
CONFIG_POLL=y
CONFIG_CAN=y
CONFIG_CAN_INIT_PRIORITY=80
CONFIG_CAN_MAX_FILTER=5

#CONFIG_SHELL=y
#CONFIG_CAN_SHELL=y
#CONFIG_DEVICE_SHELL=y

CONFIG_GPIO=y
#CONFIG_STATS=y
#CONFIG_STATS_NAMES=y
#CONFIG_STATS_SHELL=y
#CONFIG_CAN_STATS=y


CONFIG_LOG=y
CONFIG_CAN_LOG_LEVEL_DBG=y

#CONFIG_LOOPBACK_MODE=y

CONFIG_HEAP_MEM_POOL_SIZE=4000
```

## src/main.c
```c
/*
 * Copyright (c) 2018 Alexander Wachter
 *
 * SPDX-License-Identifier: Apache-2.0
 */

#include <stdio.h>

#include <zephyr/kernel.h>
#include <zephyr/sys/printk.h>
#include <zephyr/device.h>
#include <zephyr/drivers/can.h>
#include <zephyr/drivers/gpio.h>
#include <zephyr/sys/byteorder.h>

#include "u8g2port.h"

//#define COUNTER_MSG_ID 0x12345
#define COUNTER_MSG_ID 0x345

const struct device *const can_dev = DEVICE_DT_GET(DT_CHOSEN(zephyr_canbus));

void canrx(const struct device *dev, struct can_frame *frame, void *user_data){
	//printf("canrx(): Counter received: %u\n", sys_be16_to_cpu(UNALIGNED_GET((uint16_t *)&frame->data)));
	printf("canrx(): id:%u dlc:%u flags:%u data:", frame->id, frame->dlc, frame->flags);
	for(int i=0; i<frame->dlc; i++){
		printf("%02x ", frame->data[i]);
	}
	printf("\n");
}

struct node {
	uint16_t d1, d2;
	struct node *next, *prev;
};
struct node *head, *tail;
unsigned int nodelen;

void node_del(){
	struct node *del = tail;
	tail = del->prev;
	k_free(del);
	nodelen--;
}
void node_ins(uint16_t d1, uint16_t d2){
	struct node *new = k_malloc(sizeof(struct node));
	new->d1 = d1;
	new->d2 = d2;
	new->next = head;
	head = new;
	if(nodelen==0) tail = new;
	nodelen++;
	if(nodelen > 144){
		node_del();
/*
		// delete node
		struct node *del = head;
		while(del->next->next != NULL){
			del = del->next;
		}
		k_free(del->next);
		del->next = NULL;
		nodelen--;
*/
	}
}

uint32_t mapu(uint32_t in, uint32_t in_min, uint32_t in_max, uint32_t out_min, uint32_t out_max){
	return (in-in_min)*(out_max-out_min)/(in_max-in_min)+out_min;
}

volatile uint16_t lambda, temp, status;
volatile uint32_t spartan3rxcount;
void canrxlambda(const struct device *dev, struct can_frame *frame, void *user_data){
	//printf("canrxlambda(): id:%u dlc:%u flags:%u data: %02x %02x %02x %02x\n", frame->id, frame->dlc, frame->flags, frame->data[0],frame->data[1],frame->data[2],frame->data[3]);
	lambda = (uint16_t)frame->data[0]<<8 | (uint16_t)frame->data[1];
	temp = frame->data[2];
	status = frame->data[3];
	//printf("lambda:%u temp:%u status:%u\n", lambda, temp*10, status);
	//printf("lambda:%u temp:%u\n", lambda, temp*10);
	//printf("lambda:%f temp:%u\n", (float)lambda/1000.0, temp*10);
	spartan3rxcount++;
	node_ins(lambda, mapu(lambda, 800, 1200, 0, 167));
}


int main(void){
	int ret;
	printf("ethan hello\n");
	nodelen=0;
	head = NULL;

	if (!device_is_ready(can_dev)) {
		printf("CAN: Device %s not ready.\n", can_dev->name);
		return 0;
	}
	//ret = can_set_mode(can_dev, CAN_MODE_LOOPBACK);
	ret = can_set_mode(can_dev, CAN_MODE_NORMAL);
	if (ret != 0) {
		printf("Error setting CAN mode [%d]", ret);
		return 0;
	}
	ret = can_start(can_dev);
	if (ret != 0) {
		printf("Error starting CAN controller [%d]", ret);
		return 0;
	}
	//spartan 3 can filter
	const struct can_filter filter2 = { .flags=CAN_FILTER_DATA, .id=1024, .mask=CAN_STD_ID_MASK };
	can_add_rx_filter(can_dev, canrxlambda, NULL, &filter2);

	// u8g2
	u8x8initz();
	u8g2_t u8g2;
	//u8g2_Setup_ssd1309_128x64_noname0_f(&u8g2, U8G2_R0, u8x8bytez, u8x8gpioz);
	//u8g2_Setup_ssd1309_128x64_noname2_f(&u8g2, U8G2_R0, u8x8bytez, u8x8gpioz);
	u8g2_Setup_ls013b7dh05_144x168_f(&u8g2, U8G2_R0, u8x8bytez, u8x8gpioz);
	u8g2_InitDisplay(&u8g2);
	u8g2_SetPowerSave(&u8g2, 0);
	u8g2_SetFontMode(&u8g2, 1);
	u8g2_SetDrawColor(&u8g2, 2);


	char msg_lambda[20], msg_count[20], msg_avg[20];
	unsigned int count=0;
	struct node *cur;
	uint16_t tmp;
	uint32_t avg;

	while (1) {
/*
		enum can_state state;
		struct can_bus_err_cnt err_cnt = {0, 0};
		ret = can_get_state(can_dev, &state, &err_cnt);
		if (ret == 0) {
			printf("can state %d txe %d rxe %d\n", state, err_cnt.tx_err_cnt, err_cnt.rx_err_cnt);
		}
*/
/*
		UNALIGNED_PUT(sys_cpu_to_be16(counter), (uint16_t *)&counter_frame.data[0]);
		counter++;
		// This sending call is blocking until the message is sent.
		//can_send(can_dev, &counter_frame, K_MSEC(100), NULL, NULL);
*/

		sprintf(msg_lambda, "%04u", lambda);
		sprintf(msg_count, "%u %u %u %u", temp, count++, spartan3rxcount, nodelen);

		u8g2_ClearBuffer(&u8g2);

		//u8g2_SetFont(&u8g2, u8g2_font_logisoso38_tr);
		//u8g2_DrawStr(&u8g2, -3, 38, msg_lambda);
		u8g2_SetFont(&u8g2, u8g2_font_logisoso32_tr);
		u8g2_DrawStr(&u8g2, -2, 32, msg_lambda);

		u8g2_SetFont(&u8g2, u8g2_font_5x7_tr);
		u8g2_DrawStr(&u8g2, 0, 168, msg_count);

		u8g2_DrawHLine(&u8g2, 0, 83, 144);
		u8g2_DrawHLine(&u8g2, 0, 84, 144);

		avg=0;
		cur = head;
		for(int i=0; i<nodelen; i++){
			avg += cur->d1;
			u8g2_DrawPixel(&u8g2, i, cur->d2);
			u8g2_DrawPixel(&u8g2, i, cur->d2+1);
			cur = cur->next;
		}
		avg /= nodelen;

		sprintf(msg_avg, "%04u", avg);
		u8g2_SetFont(&u8g2, u8g2_font_logisoso22_tr);
		u8g2_DrawStr(&u8g2, 89, 22, msg_avg);

		u8g2_SendBuffer(&u8g2);

		k_sleep(K_MSEC(50));
	}
}
```

## src/u8g2port.c
```c
#include <zephyr/drivers/gpio.h>
#include <zephyr/drivers/spi.h>
#include <zephyr/logging/log.h>
#include "u8g2port.h"


LOG_MODULE_REGISTER(u8g2z, CONFIG_LOG_DEFAULT_LEVEL);

//struct spi_dt_spec spi = SPI_DT_SPEC_GET(DT_NODELABEL(mcp2515_spi), (SPI_OP_MODE_MASTER|SPI_TRANSFER_MSB|SPI_WORD_SET(8)), 0);
struct spi_dt_spec spi = SPI_DT_SPEC_GET(DT_NODELABEL(ssd1306_ssd1306_128x64_spi), (SPI_OP_MODE_MASTER|SPI_TRANSFER_MSB|SPI_WORD_SET(8)), 0);
//struct gpio_dt_spec gpio_reset = GPIO_DT_SPEC_GET(DT_NODELABEL(ssd1306_ssd1306_128x64_spi), reset_gpios);
//struct gpio_dt_spec gpio_datacmd = GPIO_DT_SPEC_GET(DT_NODELABEL(ssd1306_ssd1306_128x64_spi), data_cmd_gpios);
//struct gpio_dt_spec gpio_cs = GPIO_DT_SPEC_GET(DT_NODELABEL(ssdspi), cs_gpios);


int u8x8initz(){
	if(!spi_is_ready_dt(&spi)){
		LOG_ERR("SPI bus not ready");
	}else{
		LOG_ERR("SPI bus ready");
	}
	//if(gpio_pin_configure_dt(&gpio_cs, 0)){
	//	LOG_ERR("gpio cs config fail");
	//}
/*
	if(gpio_pin_configure_dt(&gpio_reset, GPIO_OUTPUT)){
		LOG_ERR("gpio reset config fail");
	}
	gpio_pin_set_dt(&gpio_reset, 0);

	if(gpio_pin_configure_dt(&gpio_datacmd, GPIO_OUTPUT)){
		LOG_ERR("gpio datacmd config fail");
	}
	gpio_pin_set_dt(&gpio_datacmd, 0);
*/
	return 0;
}

uint8_t u8x8gpioz(u8x8_t *u8x8, uint8_t msg, uint8_t arg_int, void *arg_ptr){
  switch(msg){
    case U8X8_MSG_GPIO_AND_DELAY_INIT:	// called once during init phase of u8g2/u8x8
      break;							// can be used to setup pins
    case U8X8_MSG_DELAY_NANO:			// delay arg_int * 1 nano second
      break;    
    case U8X8_MSG_DELAY_100NANO:		// delay arg_int * 100 nano seconds
      break;
    case U8X8_MSG_DELAY_10MICRO:		// delay arg_int * 10 micro seconds
	k_sleep(K_USEC(arg_int*10));
      break;
    case U8X8_MSG_DELAY_MILLI:			// delay arg_int * 1 milli second
	k_sleep(K_MSEC(arg_int));
      break;
    case U8X8_MSG_DELAY_I2C:				// arg_int is the I2C speed in 100KHz, e.g. 4 = 400 KHz
      break;							// arg_int=1: delay by 5us, arg_int = 4: delay by 1.25us
    case U8X8_MSG_GPIO_D0:				// D0 or SPI clock pin: Output level in arg_int
    //case U8X8_MSG_GPIO_SPI_CLOCK:
      break;
    case U8X8_MSG_GPIO_D1:				// D1 or SPI data pin: Output level in arg_int
    //case U8X8_MSG_GPIO_SPI_DATA:
      break;
    case U8X8_MSG_GPIO_D2:				// D2 pin: Output level in arg_int
      break;
    case U8X8_MSG_GPIO_D3:				// D3 pin: Output level in arg_int
      break;
    case U8X8_MSG_GPIO_D4:				// D4 pin: Output level in arg_int
      break;
    case U8X8_MSG_GPIO_D5:				// D5 pin: Output level in arg_int
      break;
    case U8X8_MSG_GPIO_D6:				// D6 pin: Output level in arg_int
      break;
    case U8X8_MSG_GPIO_D7:				// D7 pin: Output level in arg_int
      break;
    case U8X8_MSG_GPIO_E:				// E/WR pin: Output level in arg_int
      break;
    case U8X8_MSG_GPIO_CS:				// CS (chip select) pin: Output level in arg_int
      break;
    case U8X8_MSG_GPIO_DC:				// DC (data/cmd, A0, register select) pin: Output level in arg_int
/*
	if(arg_int){
	gpio_pin_set_dt(&gpio_datacmd, 1);
	}else{
	gpio_pin_set_dt(&gpio_datacmd, 0);
	}
*/
      break;
    case U8X8_MSG_GPIO_RESET:			// Reset pin: Output level in arg_int
/*
	if(arg_int){
	gpio_pin_set_dt(&gpio_reset, 1);
	}else{
	gpio_pin_set_dt(&gpio_reset, 0);
	}
*/
      break;
    case U8X8_MSG_GPIO_CS1:				// CS1 (chip select) pin: Output level in arg_int
      break;
    case U8X8_MSG_GPIO_CS2:				// CS2 (chip select) pin: Output level in arg_int
      break;
    case U8X8_MSG_GPIO_I2C_CLOCK:		// arg_int=0: Output low at I2C clock pin
      break;							// arg_int=1: Input dir with pullup high for I2C clock pin
    case U8X8_MSG_GPIO_I2C_DATA:			// arg_int=0: Output low at I2C data pin
      break;							// arg_int=1: Input dir with pullup high for I2C data pin
    case U8X8_MSG_GPIO_MENU_SELECT:
      u8x8_SetGPIOResult(u8x8, /* get menu select pin state */ 0);
      break;
    case U8X8_MSG_GPIO_MENU_NEXT:
      u8x8_SetGPIOResult(u8x8, /* get menu next pin state */ 0);
      break;
    case U8X8_MSG_GPIO_MENU_PREV:
      u8x8_SetGPIOResult(u8x8, /* get menu prev pin state */ 0);
      break;
    case U8X8_MSG_GPIO_MENU_HOME:
      u8x8_SetGPIOResult(u8x8, /* get menu home pin state */ 0);
      break;
    default:
      u8x8_SetGPIOResult(u8x8, 1);			// default return value
      break;
  }
  return 1;
}

uint8_t u8x8bytez(u8x8_t *u8x8, uint8_t msg, uint8_t arg_int, void *arg_ptr) {
  uint8_t *data;
//  uint8_t internal_spi_mode; 


	static uint8_t wbuf[100];
	static struct spi_buf spi_wbuf[1];
	spi_wbuf[0].buf = wbuf;
	//spi_wbuf[0].len = 0;
	static struct spi_buf_set spi_set_wbuf = { spi_wbuf, 1 };

  switch(msg) {
    case U8X8_MSG_BYTE_SEND:
      data = (uint8_t *)arg_ptr;
      while( arg_int > 0 ) {
//        SPI.transfer((uint8_t)*data);

	wbuf[spi_wbuf[0].len] = (uint8_t)*data;
	spi_wbuf[0].len++;

        data++;
        arg_int--;
      }  
      break;
    case U8X8_MSG_BYTE_INIT:
//      u8x8_gpio_SetCS(u8x8, u8x8->display_info->chip_disable_level);
//      SPI.begin();
      break;
    case U8X8_MSG_BYTE_SET_DC:
      u8x8_gpio_SetDC(u8x8, arg_int);
      break;
    case U8X8_MSG_BYTE_START_TRANSFER:

	spi_wbuf[0].len = 0;



//      /* SPI mode has to be mapped to the mode of the current controller, at least Uno, Due, 101 have different SPI_MODEx values */
//      internal_spi_mode =  0;
//      switch(u8x8->display_info->spi_mode) {
//        case 0: internal_spi_mode = SPI_MODE0; break;
//        case 1: internal_spi_mode = SPI_MODE1; break;
//        case 2: internal_spi_mode = SPI_MODE2; break;
//        case 3: internal_spi_mode = SPI_MODE3; break;
//      }
//      SPI.beginTransaction(SPISettings(u8x8->display_info->sck_clock_hz, MSBFIRST, internal_spi_mode));
//      u8x8_gpio_SetCS(u8x8, u8x8->display_info->chip_enable_level);  
//      u8x8->gpio_and_delay_cb(u8x8, U8X8_MSG_DELAY_NANO, u8x8->display_info->post_chip_enable_wait_ns, NULL);
      break;
    case U8X8_MSG_BYTE_END_TRANSFER:      

	spi_write_dt(&spi, &spi_set_wbuf);

//      u8x8->gpio_and_delay_cb(u8x8, U8X8_MSG_DELAY_NANO, u8x8->display_info->pre_chip_disable_wait_ns, NULL);
//      u8x8_gpio_SetCS(u8x8, u8x8->display_info->chip_disable_level);
//      SPI.endTransaction();

      break;
    default:
      return 0;
  }  
  return 1;
}
```

## src/u8g2port.h
```c
#include "../u8g2/csrc/u8g2.h"

int u8x8initz();
uint8_t u8x8gpioz(u8x8_t *u8x8, uint8_t msg, uint8_t arg_int, void *arg_ptr);
uint8_t u8x8bytez(u8x8_t *u8x8, uint8_t msg, uint8_t arg_int, void *arg_ptr);
```
